## Documentation/devicetree/bindings/watchdog/apple,s5l8720-wdt.yaml
```yaml
# SPDX-License-Identifier: (GPL-2.0-only OR BSD-2-Clause)
%YAML 1.2
---
$id: http://devicetree.org/schemas/watchdog/apple,s5l8720-wdt.yaml#
$schema: http://devicetree.org/meta-schemas/core.yaml#

title: Apple S5L8720 watchdog timer

maintainers:
  - Kailash <kailash.sudhakar@gmail.com>

description:
  The watchdog timer of the S5L8720, a child of the system controller node
  that holds its registers (mfd/apple,s5l8723-syscon.yaml).

allOf:
  - $ref: watchdog.yaml#

properties:
  compatible:
    const: apple,s5l8720-wdt

  clock-frequency:
    description: Rate of the bus clock the counter runs from, in Hz.

required:
  - compatible
  - clock-frequency

unevaluatedProperties: false

examples:
  - |
    watchdog {
        compatible = "apple,s5l8720-wdt";
        clock-frequency = <133000000>;
    };
```

## arch/arm/configs/apple_n72_defconfig
```kconfig
CONFIG_SYSVIPC=y
CONFIG_POSIX_MQUEUE=y
CONFIG_PERF_EVENTS=y
CONFIG_PREEMPT_VOLUNTARY=y
CONFIG_HZ_250=y
CONFIG_NO_HZ_IDLE=y
CONFIG_HIGH_RES_TIMERS=y
CONFIG_ARCH_S5L87XX=y
CONFIG_CPU_S5L8720=y
CONFIG_CMDLINE="console=tty0 console=ttySAC0 mem_sleep_default=s2idle fbcon=font:VGA8x8"
CONFIG_PRINTK_TIME=y
CONFIG_DEBUG_KERNEL=y
CONFIG_S5L8720_TIMER=y
CONFIG_SERIAL_SAMSUNG=y
CONFIG_SERIAL_SAMSUNG_CONSOLE=y
CONFIG_VFP=y
CONFIG_BLK_DEV_INITRD=y
CONFIG_RD_GZIP=y
CONFIG_DEVTMPFS=y
CONFIG_DEVTMPFS_MOUNT=y
CONFIG_TMPFS=y
CONFIG_REGMAP=y
CONFIG_REGMAP_MMIO=y
CONFIG_MFD_SYSCON=y
CONFIG_POWER_RESET=y
CONFIG_POWER_RESET_SYSCON=y
# Display handed over by U-Boot
CONFIG_FB=y
CONFIG_FB_SIMPLE=y
CONFIG_APPLE_MBX=y
CONFIG_SYSFB_SIMPLEFB=y
CONFIG_FRAMEBUFFER_CONSOLE=y
CONFIG_FONTS=y
CONFIG_FONT_8x8=y
CONFIG_FONT_8x16=y
CONFIG_VT=y
CONFIG_VT_CONSOLE=y
# USB gadget (ConfigFS CDC ECM networking and FunctionFS MTP)
CONFIG_PHY_S5L8720_USB2=y
CONFIG_USB_DWC2=y
CONFIG_USB_GADGET=y
CONFIG_USB_CONFIGFS=y
CONFIG_USB_CONFIGFS_ECM=y
CONFIG_USB_CONFIGFS_F_FS=y
CONFIG_NET=y
CONFIG_UNIX=y
CONFIG_INET=y
# udhcpc (raw packet sockets)
CONFIG_PACKET=y
# Keep the image small
# CONFIG_MODULES is not set
CONFIG_SWAP=y
CONFIG_CC_OPTIMIZE_FOR_SIZE=y
CONFIG_DEBUG_FS=y
CONFIG_GPIOLIB=y
CONFIG_GPIO_CDEV=y
CONFIG_PINCTRL=y
CONFIG_PINCTRL_S5L8720=y
CONFIG_INPUT_EVDEV=y
CONFIG_I2C=y
CONFIG_I2C_CHARDEV=y
CONFIG_I2C_S5L8702=y
CONFIG_BACKLIGHT_CLASS_DEVICE=y
CONFIG_MFD_APPLE_N72_PMU=y
CONFIG_KEXEC=y
CONFIG_KEYBOARD_GPIO=y
CONFIG_SPI=y
CONFIG_SPI_S5L8720=y
CONFIG_MTD=y
CONFIG_MTD_SPI_NOR=y
CONFIG_MTD_OF_PARTS=y
CONFIG_MTD_BLOCK=y
CONFIG_INPUT_TOUCHSCREEN=y
CONFIG_INPUT_MISC=y
CONFIG_INPUT_UINPUT=y
CONFIG_TOUCHSCREEN_ZEPHYR2=y
CONFIG_FW_LOADER=y
CONFIG_MMC=y
CONFIG_PWRSEQ_SIMPLE=y
CONFIG_MMC_S5L8900_SDIO=y
CONFIG_CFG80211=y
# wpa_supplicant's wext driver: no libnl in the initramfs
CONFIG_CFG80211_WEXT=y
# Answer incoming connections (SSH) promptly; power save sleeps through ARP
# CONFIG_CFG80211_DEFAULT_PS is not set
CONFIG_WLAN=y
CONFIG_WLAN_VENDOR_BROADCOM=y
CONFIG_BRCMFMAC=y
CONFIG_BRCMFMAC_SDIO=y
CONFIG_NETDEVICES=y
CONFIG_SENSORS_LIS3_I2C=y
CONFIG_ISL29003=y
CONFIG_WATCHDOG=y
CONFIG_S5L8720_WATCHDOG=y
CONFIG_RTC_CLASS=y
CONFIG_RTC_HCTOSYS=y
CONFIG_POWER_SUPPLY=y
CONFIG_REGULATOR=y
CONFIG_BT=y
CONFIG_BT_HCIUART=y
CONFIG_BT_HCIUART_SERDEV=y
CONFIG_BT_HCIUART_BCM=y
CONFIG_SERIAL_DEV_BUS=y
CONFIG_SERIAL_DEV_CTRL_TTYPORT=y
CONFIG_REGULATOR_FIXED_VOLTAGE=y
CONFIG_BLK_DEV_N72_NAND=y
CONFIG_DMADEVICES=y
CONFIG_AMBA_PL08X=y
CONFIG_SOUND=y
CONFIG_SND=y
CONFIG_SND_SOC=y
CONFIG_SND_SOC_S5L8720_I2S=y
CONFIG_S5L8720_AMC=y
CONFIG_SND_SOC_CS42L58=y
CONFIG_SND_SOC_LM48821=y
CONFIG_SND_SIMPLE_CARD=y
# compressed swap in RAM (zram, LZ4)
CONFIG_ZSMALLOC=y
CONFIG_ZRAM=y
CONFIG_ZRAM_BACKEND_LZ4=y
CONFIG_ZRAM_DEF_COMP_LZ4=y
CONFIG_DRM=y
CONFIG_DRM_N72_CLCD=y
CONFIG_DRM_N72_LCD=y
CONFIG_DRM_FBDEV_EMULATION=y
CONFIG_DRM_CLIENT_SELECTION=y
CONFIG_DRM_CLIENT_DEFAULT_FBDEV=y
CONFIG_DMA_SHARED_BUFFER=y
CONFIG_CMA=y
CONFIG_DMA_CMA=y
CONFIG_CMA_SIZE_MBYTES=16
CONFIG_EXT4_FS=y
CONFIG_HFSPLUS_FS=y
CONFIG_NLS_UTF8=y
CONFIG_MEDIA_SUPPORT=y
CONFIG_MEDIA_SUPPORT_FILTER=y
CONFIG_MEDIA_PLATFORM_SUPPORT=y
CONFIG_V4L_MEM2MEM_DRIVERS=y
```

## drivers/block/n72-nand/Kconfig
```kconfig
# SPDX-License-Identifier: GPL-2.0-only
config BLK_DEV_N72_NAND
	bool "Apple S5L8720 FMSS NAND block driver"
	depends on CPU_S5L8720 || COMPILE_TEST
	help
	  Driver for the NAND controller of the iPod touch 2G. Page reads,
	  programs and erases run Apple's sequencer programs, loaded as
	  firmware; without them it can only reset the chips and read their
	  IDs. Apple's VSVFL and YAFTL layers on top present iOS's partitions
	  and an image file on its data partition as disks.

config BLK_DEV_N72_NAND_DEBUG
	bool "Raw test files for the S5L8720 FMSS NAND controller"
	depends on BLK_DEV_N72_NAND
	help
	  Files in sysfs to read the chips' IDs, single pages and the
	  controller's registers, to erase and program blocks of the
	  reserve pool listed in the write_allow parameter, and to check
	  the FTL and write test pages through it beyond what iOS exposes
	  (ftl_check, ftl_test). For work on the driver only.

	  If unsure, say N.
```

## drivers/gpu/drm/mbx/Kconfig
```kconfig
# SPDX-License-Identifier: GPL-2.0-only
config APPLE_MBX
	tristate "PowerVR MBX Lite on Apple S5L8720"
	depends on ARCH_S5L87XX || COMPILE_TEST
	depends on DRM
	help
	  PowerVR MBX Lite GPU in the Apple S5L8720 (iPod touch 2nd
	  generation): power-on, reset, GPU MMU, buffer allocation and
	  command submission (2D, 3D blits, tile accelerator frames)
	  through a DRM render node.
```

## drivers/media/platform/apple/Kconfig
```kconfig
# SPDX-License-Identifier: GPL-2.0-only

comment "Apple (Samsung S5L87xx) media platform drivers"

config VIDEO_S5L8720_SCALER
	tristate "Samsung/Apple S5L8720 scaler and colour space converter"
	depends on V4L_MEM2MEM_DRIVERS
	depends on VIDEO_DEV
	depends on ARCH_S5L87XX || COMPILE_TEST
	select VIDEOBUF2_DMA_CONTIG
	select V4L2_MEM2MEM_DEV
	default ARCH_S5L87XX
	help
	  The memory-to-memory scaler of the S5L8720 (iPod touch 2G): scaling
	  with polyphase filters and conversion between NV12, RGB565 and
	  32-bit RGB, one picture at a time.

config VIDEO_S5L8720_VDEC
	tristate

config VIDEO_S5L8720_H264
	tristate "Samsung/Apple S5L8720 H.264 decoder"
	depends on V4L_MEM2MEM_DRIVERS
	depends on VIDEO_DEV
	depends on ARCH_S5L87XX || COMPILE_TEST
	select MEDIA_CONTROLLER
	select VIDEO_S5L8720_VDEC
	select VIDEOBUF2_DMA_CONTIG
	select V4L2_MEM2MEM_DEV
	default ARCH_S5L87XX
	help
	  The H.264 decoder of the S5L8720 (iPod touch 2G) as a V4L2
	  stateless decoder: progressive Baseline, Main and High profile
	  streams, one slice per request, pictures in NV12.

config VIDEO_S5L8720_MPVD
	tristate "Samsung/Apple S5L8720 MPEG-4 and H.263 decoder"
	depends on V4L_MEM2MEM_DRIVERS
	depends on VIDEO_DEV
	depends on ARCH_S5L87XX || COMPILE_TEST
	select VIDEOBUF2_DMA_CONTIG
	select V4L2_MEM2MEM_DEV
	select VIDEO_S5L8720_VDEC
	default ARCH_S5L87XX
	help
	  The MPEG-4 Part 2 (Simple Profile) and H.263 decoder of the
	  S5L8720 (iPod touch 2G) as a V4L2 stateful decoder: one picture
	  per buffer, pictures in NV12.
```

## drivers/soc/apple/Kconfig
```kconfig
# SPDX-License-Identifier: GPL-2.0-only

if ARCH_APPLE || COMPILE_TEST

menu "Apple SoC drivers"

config APPLE_MAILBOX
	tristate "Apple SoC mailboxes"
	depends on PM
	depends on ARCH_APPLE || (64BIT && COMPILE_TEST)
	default ARCH_APPLE
	help
	  Apple SoCs have various co-processors required for certain
	  peripherals to work (NVMe, display controller, etc.). This
	  driver adds support for the mailbox controller used to
	  communicate with those.

	  Say Y here if you have an Apple SoC.

config APPLE_RTKIT
	tristate "Apple RTKit co-processor IPC protocol"
	depends on APPLE_MAILBOX
	depends on ARCH_APPLE || COMPILE_TEST
	default ARCH_APPLE
	help
	  Apple SoCs such as the M1 come with various co-processors running
	  their proprietary RTKit operating system. This option enables support
	  for the protocol library used to communicate with those. It is used
	  by various client drivers.

	  Say 'y' here if you have an Apple SoC.

config APPLE_SART
	tristate "Apple SART DMA address filter"
	depends on ARCH_APPLE || COMPILE_TEST
	default ARCH_APPLE
	help
	  Apple SART is a simple DMA address filter used on Apple SoCs such
	  as the M1. It is usually required for the NVMe coprocessor which does
	  not use a proper IOMMU.

	  Say 'y' here if you have an Apple SoC.

endmenu

endif

config APPLE_N72_COREV
	bool "iPod touch 2G low core voltage state"
	depends on CPU_S5L8720 || COMPILE_TEST
	depends on PM_SLEEP && REGULATOR
	default CPU_S5L8720
	help
	  Run the S5L8720's core at 1.05 V with the system clock divided by
	  2 while the display is off and there is no USB power, as iOS
	  does, and at 1.20 V otherwise and across every sleep, restart
	  and kexec. The rail is the PMU's DOWN0 regulator.

	  Say Y for the iPod touch 2nd generation (N72).
```

## sound/soc/apple/Kconfig
```kconfig
config SND_SOC_APPLE_MCA
	tristate "Apple Silicon MCA driver"
	depends on ARCH_APPLE || COMPILE_TEST
	select SND_DMAENGINE_PCM
	default ARCH_APPLE
	help
	  This option enables an ASoC platform driver for MCA peripherals found
	  on Apple Silicon SoCs.

config SND_SOC_S5L8720_I2S
	tristate "Samsung/Apple S5L8720 I2S (iPod touch 2G)"
	depends on ARCH_S5L87XX || COMPILE_TEST
	select SND_SOC_GENERIC_DMAENGINE_PCM
	help
	  ASoC CPU DAI driver for the I2S controller of the S5L8720 SoC, as
	  used for the CS42L58 codec of the iPod touch 2nd generation (N72).
```
