## Documentation/devicetree/bindings/mfd/apple,n72-pmu.yaml
```yaml
# SPDX-License-Identifier: (GPL-2.0-only OR BSD-2-Clause)
%YAML 1.2
---
$id: http://devicetree.org/schemas/mfd/apple,n72-pmu.yaml#
$schema: http://devicetree.org/meta-schemas/core.yaml#

title: Apple iPod touch 2G (N72) power management unit

maintainers:
  - Kailash <kailash.sudhakar@gmail.com>

description: |
  I2C power management unit of the N72: backlight, power-off, RTC, battery
  and USB power supplies, GPIOs, LDO regulators and the SoC core rail. The
  GPIO controller is registered only when "gpio-controller" is present.

properties:
  compatible:
    const: apple,n72-pmu

  reg:
    maxItems: 1

  interrupts:
    maxItems: 1

  system-power-controller: true

  monitored-battery:
    $ref: /schemas/types.yaml#/definitions/phandle
    description: simple-battery node used for the battery capacity table.

  gpio-controller: true

  "#gpio-cells":
    const: 2

  interrupt-controller: true

  "#interrupt-cells":
    const: 2

  regulators:
    type: object
    description:
      LDO regulators and DOWN0; only those described here can be switched
      or set.

    properties:
      down0:
        type: object
        $ref: /schemas/regulator/regulator.yaml#
        unevaluatedProperties: false
        description:
          DOWN0, the buck converter of the SoC core rail, 725 mV to 1500 mV
          in steps of 25 mV. It has no enable control and is always on.

    patternProperties:
      "^ldo[0-9]+$":
        type: object
        $ref: /schemas/regulator/regulator.yaml#
        unevaluatedProperties: false

    additionalProperties: false

required:
  - compatible
  - reg

additionalProperties: false

examples:
  - |
    #include <dt-bindings/interrupt-controller/irq.h>

    i2c {
        #address-cells = <1>;
        #size-cells = <0>;

        pmic@73 {
            compatible = "apple,n72-pmu";
            reg = <0x73>;
            interrupts-extended = <&gpio 0x61 IRQ_TYPE_LEVEL_LOW>;
            system-power-controller;
            monitored-battery = <&battery>;
            gpio-controller;
            #gpio-cells = <2>;
            interrupt-controller;
            #interrupt-cells = <2>;

            regulators {
                down0 {
                    regulator-name = "core";
                    regulator-min-microvolt = <725000>;
                    regulator-max-microvolt = <1500000>;
                    regulator-always-on;
                    regulator-boot-on;
                };

                ldo3 {
                    regulator-name = "touch";
                    regulator-min-microvolt = <1800000>;
                    regulator-max-microvolt = <1800000>;
                    regulator-always-on;
                };

                ldo4 {
                    regulator-name = "lcd";
                    regulator-min-microvolt = <3000000>;
                    regulator-max-microvolt = <3000000>;
                    regulator-boot-on;
                };
            };
        };
    };
```

## Documentation/devicetree/bindings/mfd/apple,s5l8723-syscon.yaml
```yaml
# SPDX-License-Identifier: (GPL-2.0-only OR BSD-2-Clause)
%YAML 1.2
---
$id: http://devicetree.org/schemas/mfd/apple,s5l8723-syscon.yaml#
$schema: http://devicetree.org/meta-schemas/core.yaml#

title: Apple S5L87xx watchdog system controller

maintainers:
  - Kailash <kailash.sudhakar@gmail.com>

description:
  The watchdog registers of the S5L8720 and S5L8723. A syscon-reboot child
  resets the SoC by writing the control register; on the S5L8720 a watchdog
  child runs the timer itself.

properties:
  compatible:
    items:
      - const: apple,s5l8723-syscon
      - const: syscon
      - const: simple-mfd

  reg:
    maxItems: 1

  watchdog:
    $ref: /schemas/watchdog/apple,s5l8720-wdt.yaml#

patternProperties:
  "^syscon-reboot(@[0-9a-f]+)?$":
    $ref: /schemas/power/reset/syscon-reboot.yaml#
    unevaluatedProperties: false

required:
  - compatible
  - reg

additionalProperties: false

examples:
  - |
    syscon@3c800000 {
        compatible = "apple,s5l8723-syscon", "syscon", "simple-mfd";
        reg = <0x3c800000 0x8>;

        syscon-reboot {
            compatible = "syscon-reboot";
            offset = <0x0>;
            value = <0x100000>;
        };

        watchdog {
            compatible = "apple,s5l8720-wdt";
            clock-frequency = <133000000>;
        };
    };
```

## Documentation/devicetree/bindings/mmc/apple,s5l8900-sdio.yaml
```yaml
# SPDX-License-Identifier: (GPL-2.0-only OR BSD-2-Clause)
%YAML 1.2
---
$id: http://devicetree.org/schemas/mmc/apple,s5l8900-sdio.yaml#
$schema: http://devicetree.org/meta-schemas/core.yaml#

title: Apple S5L8900 / S5L8720 SDIO host controller

maintainers:
  - Kailash <kailash.sudhakar@gmail.com>

allOf:
  - $ref: mmc-controller.yaml#

properties:
  compatible:
    oneOf:
      - const: apple,s5l8900-sdio
      - items:
          - const: apple,s5l8720-sdio
          - const: apple,s5l8900-sdio

  reg:
    minItems: 1
    items:
      - description: controller registers
      - description: clock gate register, used when there is no clock

  interrupts:
    maxItems: 1

  clocks:
    maxItems: 1

  clock-frequency: true

  apple,gate-mask:
    $ref: /schemas/types.yaml#/definitions/uint32
    description: Required when the second "reg" entry is given.

required:
  - compatible
  - reg
  - interrupts

unevaluatedProperties: false

examples:
  - |
    mmc@38d00000 {
        compatible = "apple,s5l8720-sdio", "apple,s5l8900-sdio";
        reg = <0x38d00000 0x1000>;
        clocks = <&clkgate 0 8>;
        clock-frequency = <51200000>;
        interrupt-parent = <&vic1>;
        interrupts = <10>;
        bus-width = <4>;
        max-frequency = <25600000>;
        non-removable;
        cap-sdio-irq;
        keep-power-in-suspend;
        mmc-pwrseq = <&wifi_pwrseq>;
        vmmc-supply = <&wlbt_power>;
    };
```

## Documentation/devicetree/bindings/mtd/apple,s5l8720-fmss.yaml
```yaml
# SPDX-License-Identifier: (GPL-2.0-only OR BSD-2-Clause)
%YAML 1.2
---
$id: http://devicetree.org/schemas/mtd/apple,s5l8720-fmss.yaml#
$schema: http://devicetree.org/meta-schemas/core.yaml#

title: Apple S5L8720 FMSS NAND flash controller

maintainers:
  - Kailash <kailash.sudhakar@gmail.com>

properties:
  compatible:
    const: apple,s5l8720-fmss

  reg:
    maxItems: 1

  interrupts:
    maxItems: 1

  clocks:
    minItems: 1
    maxItems: 2
    description: Clocks, all enabled together.

  apple,ce-bitmap:
    $ref: /schemas/types.yaml#/definitions/uint32
    default: 3
    description: Bitmap of populated chip enables.

  apple,page-size:
    $ref: /schemas/types.yaml#/definitions/uint32
    default: 8192
    description:
      Page size in bytes; the driver rejects values it cannot split into its
      chunks.

  apple,read-setup-clks:
    $ref: /schemas/types.yaml#/definitions/uint32
    description: Read timing setup value, in clocks.

  apple,read-hold-clks:
    $ref: /schemas/types.yaml#/definitions/uint32
    description: Read timing hold value, in clocks.

  apple,read-dccycle-clks:
    $ref: /schemas/types.yaml#/definitions/uint32
    description: Read timing DC cycle value, in clocks.

  apple,expected-readid:
    $ref: /schemas/types.yaml#/definitions/uint32
    description: Chip ID the driver expects to read; see the driver.

  apple,blocks-per-ce:
    $ref: /schemas/types.yaml#/definitions/uint32
    default: 4148
    description: Blocks per chip enable.

  apple,pages-per-block:
    $ref: /schemas/types.yaml#/definitions/uint32
    default: 128
    description: Pages per block.

required:
  - compatible
  - reg
  - interrupts
  - clocks

additionalProperties: false

examples:
  - |
    flash-controller@38a00000 {
        compatible = "apple,s5l8720-fmss";
        reg = <0x38a00000 0x1000>;
        interrupt-parent = <&vic1>;
        interrupts = <22>;
        clocks = <&clkgate 0 5>, <&clkgate 0 9>;
        apple,ce-bitmap = <3>;
        apple,read-setup-clks = <1>;
        apple,read-hold-clks = <1>;
        apple,read-dccycle-clks = <2>;
        apple,page-size = <8192>;
        apple,expected-readid = <0x3294d798>;
    };
```

## Documentation/devicetree/bindings/phy/apple,s5l8720-otgphy.yaml
```yaml
# SPDX-License-Identifier: (GPL-2.0-only OR BSD-2-Clause)
%YAML 1.2
---
$id: http://devicetree.org/schemas/phy/apple,s5l8720-otgphy.yaml#
$schema: http://devicetree.org/meta-schemas/core.yaml#

title: Apple S5L8720 USB OTG PHY

maintainers:
  - Kailash <kailash.sudhakar@gmail.com>

description:
  The USB 2.0 PHY of the S5L8720's DesignWare OTG controller. The driver
  keeps the tuning registers the boot loader programmed and writes them
  back on every power on. It takes no clocks or resets; the PHY's clock gate
  is left as the boot loader opened it.

properties:
  compatible:
    const: apple,s5l8720-otgphy

  reg:
    maxItems: 1

  "#phy-cells":
    const: 0

required:
  - compatible
  - reg
  - "#phy-cells"

additionalProperties: false

examples:
  - |
    usbphy: usbphy@3c400000 {
        compatible = "apple,s5l8720-otgphy";
        reg = <0x3c400000 0x100>;
        #phy-cells = <0>;
    };
```

## Documentation/devicetree/bindings/soc/samsung/apple,n72-core-voltage.yaml
```yaml
# SPDX-License-Identifier: (GPL-2.0-only OR BSD-2-Clause)
%YAML 1.2
---
$id: http://devicetree.org/schemas/soc/samsung/apple,n72-core-voltage.yaml#
$schema: http://devicetree.org/meta-schemas/core.yaml#

title: Apple iPod touch 2G (N72) core voltage states

maintainers:
  - Kailash <kailash.sudhakar@gmail.com>

description: |
  The S5L8720's two core voltage states, as iOS's clock controller keeps
  them: 1.20 V, at which the system clock may run undivided, and 1.05 V,
  with the system clock divided by 2, while the display and the USB PHY
  are off. The core rail is the PMU's DOWN0 converter.

properties:
  compatible:
    const: apple,n72-core-voltage

  core-supply:
    description: The SoC core rail (the PMU's down0 regulator).

required:
  - compatible
  - core-supply

additionalProperties: false

examples:
  - |
    core-voltage {
        compatible = "apple,n72-core-voltage";
        core-supply = <&down0>;
    };
```

## Documentation/devicetree/bindings/soc/samsung/apple,n72-sleep.yaml
```yaml
# SPDX-License-Identifier: (GPL-2.0-only OR BSD-2-Clause)
%YAML 1.2
---
$id: http://devicetree.org/schemas/soc/samsung/apple,n72-sleep.yaml#
$schema: http://devicetree.org/meta-schemas/core.yaml#

title: Apple iPod touch 2G (N72) suspend-to-RAM support

maintainers:
  - Kailash <kailash.sudhakar@gmail.com>

properties:
  compatible:
    const: apple,n72-sleep

  reg:
    minItems: 1
    items:
      - description: AES engine registers
      - description: clock controller registers (optional)

  clocks:
    maxItems: 1

  apple,pmu:
    $ref: /schemas/types.yaml#/definitions/phandle
    description: The N72 PMU (apple,n72-pmu).

required:
  - compatible
  - reg

additionalProperties: false

examples:
  - |
    sleep@38c00000 {
        compatible = "apple,n72-sleep";
        reg = <0x38c00000 0x100>, <0x3c500000 0x100>;
        clocks = <&clkgate 0 7>;
        apple,pmu = <&pmu>;
    };
```

## Documentation/devicetree/bindings/sound/apple,s5l8720-amc.yaml
```yaml
# SPDX-License-Identifier: (GPL-2.0-only OR BSD-2-Clause)
%YAML 1.2
---
$id: http://devicetree.org/schemas/sound/apple,s5l8720-amc.yaml#
$schema: http://devicetree.org/meta-schemas/core.yaml#

title: Apple S5L8720 AMC audio coprocessor

maintainers:
  - Kailash <kailash.sudhakar@gmail.com>

properties:
  compatible:
    const: apple,s5l8720-amc

  reg:
    items:
      - description: Data Engine registers
      - description: SRAM

  interrupts:
    maxItems: 1

  clocks:
    minItems: 1
    maxItems: 3
    description: Clocks, all enabled together.

  apple,bus-frequency:
    $ref: /schemas/types.yaml#/definitions/uint32
    description: Bus clock frequency in Hz; optional.

required:
  - compatible
  - reg
  - interrupts
  - clocks

additionalProperties: false

examples:
  - |
    audio-codec@38500000 {
        compatible = "apple,s5l8720-amc";
        reg = <0x38500000 0x2000>, <0x22000000 0x30000>;
        interrupt-parent = <&vic0>;
        interrupts = <18>;
        clocks = <&clkgate 0 3>, <&clkgate 0 4>, <&clkgate 1 17>;
        apple,bus-frequency = <133000000>;
    };
```

## Documentation/devicetree/bindings/sound/apple,s5l8720-i2s.yaml
```yaml
# SPDX-License-Identifier: (GPL-2.0-only OR BSD-2-Clause)
%YAML 1.2
---
$id: http://devicetree.org/schemas/sound/apple,s5l8720-i2s.yaml#
$schema: http://devicetree.org/meta-schemas/core.yaml#

title: Apple S5L8720 I2S controller

maintainers:
  - Kailash <kailash.sudhakar@gmail.com>

allOf:
  - $ref: dai-common.yaml#

properties:
  compatible:
    const: apple,s5l8720-i2s

  reg:
    maxItems: 1

  interrupts:
    maxItems: 1

  clocks:
    items:
      - description: the I2S block's gate
      - description: the gate iOS calls DMACM

  clock-names:
    items:
      - const: i2s
      - const: dmacm

  dmas:
    maxItems: 2

  dma-names:
    items:
      - const: tx
      - const: rx

  "#sound-dai-cells":
    const: 0

required:
  - compatible
  - reg
  - "#sound-dai-cells"

unevaluatedProperties: false

examples:
  - |
    i2s@3ca00000 {
        compatible = "apple,s5l8720-i2s";
        reg = <0x3ca00000 0x1000>;
        interrupt-parent = <&vic1>;
        interrupts = <12>;
        clocks = <&clkgate 1 7>, <&clkgate 3 8>;
        clock-names = "i2s", "dmacm";
        dmas = <&dmac0 10 2>, <&dmac0 11 2>;
        dma-names = "tx", "rx";
        #sound-dai-cells = <0>;
    };
```

## Documentation/devicetree/bindings/sound/cirrus,cs42l58.yaml
```yaml
# SPDX-License-Identifier: (GPL-2.0-only OR BSD-2-Clause)
%YAML 1.2
---
$id: http://devicetree.org/schemas/sound/cirrus,cs42l58.yaml#
$schema: http://devicetree.org/meta-schemas/core.yaml#

title: Cirrus Logic CS42L58 audio codec

maintainers:
  - Kailash <kailash.sudhakar@gmail.com>

allOf:
  - $ref: dai-common.yaml#

properties:
  compatible:
    const: cirrus,cs42l58

  reg:
    maxItems: 1

  reset-gpios:
    maxItems: 1

  "#sound-dai-cells":
    const: 0

required:
  - compatible
  - reg
  - reset-gpios
  - "#sound-dai-cells"

unevaluatedProperties: false

examples:
  - |
    #include <dt-bindings/gpio/gpio.h>

    i2c {
        #address-cells = <1>;
        #size-cells = <0>;

        audio-codec@4a {
            compatible = "cirrus,cs42l58";
            reg = <0x4a>;
            reset-gpios = <&gpio 72 GPIO_ACTIVE_LOW>;
            #sound-dai-cells = <0>;
        };
    };
```

## Documentation/devicetree/bindings/sound/ti,lm48821.yaml
```yaml
# SPDX-License-Identifier: (GPL-2.0-only OR BSD-2-Clause)
%YAML 1.2
---
$id: http://devicetree.org/schemas/sound/ti,lm48821.yaml#
$schema: http://devicetree.org/meta-schemas/core.yaml#

title: Texas Instruments LM48821 speaker amplifier

maintainers:
  - Kailash <kailash.sudhakar@gmail.com>

properties:
  compatible:
    const: ti,lm48821

  reg:
    maxItems: 1

  enable-gpios:
    maxItems: 1

required:
  - compatible
  - reg
  - enable-gpios

additionalProperties: false

examples:
  - |
    #include <dt-bindings/gpio/gpio.h>

    i2c {
        #address-cells = <1>;
        #size-cells = <0>;

        amplifier@76 {
            compatible = "ti,lm48821";
            reg = <0x76>;
            enable-gpios = <&gpio 114 GPIO_ACTIVE_LOW>;
        };
    };
```
