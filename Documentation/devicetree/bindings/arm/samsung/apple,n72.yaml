## Documentation/devicetree/bindings/arm/samsung/apple,n72.yaml
```yaml
# SPDX-License-Identifier: (GPL-2.0-only OR BSD-2-Clause)
%YAML 1.2
---
$id: http://devicetree.org/schemas/arm/samsung/apple,n72.yaml#
$schema: http://devicetree.org/meta-schemas/core.yaml#

title: Apple iPod touch 2G (N72) board

maintainers:
  - Kailash <kailash.sudhakar@gmail.com>

description:
  Board compatible of the iPod touch 2nd generation (N72AP), built around the
  Samsung/Apple S5L8720 SoC.

properties:
  $nodename:
    const: /
  compatible:
    items:
      - const: apple,n72
      - const: samsung,s5l8720

additionalProperties: true
```

## Documentation/devicetree/bindings/clock/apple,s5l8720-clock-gates.yaml
```yaml
# SPDX-License-Identifier: (GPL-2.0-only OR BSD-2-Clause)
%YAML 1.2
---
$id: http://devicetree.org/schemas/clock/apple,s5l8720-clock-gates.yaml#
$schema: http://devicetree.org/meta-schemas/core.yaml#

title: Apple S5L8720 clock gates

maintainers:
  - Kailash <kailash.sudhakar@gmail.com>

description:
  Clock gates of the S5L8720. A clock is selected by two cells, the index of
  the gate register (0 to 4, registers 0x48, 0x4c, 0x58, 0x68 and 0x6c) and
  the bit within it. Cell <3 5> controls the grouped MBX GPU gate bits (bits
  5-7 of 0x68) atomically; <3 6> and <3 7> are rejected. The gates share their
  parent clock, the first entry of "clocks".

properties:
  compatible:
    const: apple,s5l8720-clock-gates

  reg:
    maxItems: 1

  clocks:
    maxItems: 1

  "#clock-cells":
    const: 2

  apple,gates-off:
    $ref: /schemas/types.yaml#/definitions/uint32-matrix
    description:
      List of <register-index bit> pairs naming gates to close at boot.
    items:
      items:
        - description: gate register index
        - description: bit in the gate register

required:
  - compatible
  - reg
  - clocks
  - "#clock-cells"

additionalProperties: false

examples:
  - |
    clock-controller@3c500000 {
        compatible = "apple,s5l8720-clock-gates";
        reg = <0x3c500000 0x100>;
        clocks = <&nclk>;
        #clock-cells = <2>;
        apple,gates-off = <0 3>, <0 4>, <1 17>;
    };
```

## Documentation/devicetree/bindings/display/apple,n72-display.yaml
```yaml
# SPDX-License-Identifier: (GPL-2.0-only OR BSD-2-Clause)
%YAML 1.2
---
$id: http://devicetree.org/schemas/display/apple,n72-display.yaml#
$schema: http://devicetree.org/meta-schemas/core.yaml#

title: Apple iPod touch 2G (N72) display subsystem

maintainers:
  - Kailash <kailash.sudhakar@gmail.com>

description:
  KMS device of the N72 display. It has no registers of its own; it refers to
  the CLCD controller (apple,n72-lcd) and to the boot framebuffer.

properties:
  compatible:
    const: apple,n72-display

  apple,clcd:
    $ref: /schemas/types.yaml#/definitions/phandle
    description: The CLCD controller node (apple,n72-lcd).

  apple,framebuffer:
    $ref: /schemas/types.yaml#/definitions/phandle
    description: The boot framebuffer node.

  interrupts:
    maxItems: 1
    description: Optional; the CLCD frame interrupt.

required:
  - compatible
  - apple,clcd
  - apple,framebuffer

additionalProperties: false

examples:
  - |
    display-subsystem {
        compatible = "apple,n72-display";
        apple,clcd = <&clcd>;
        apple,framebuffer = <&framebuffer0>;
        interrupt-parent = <&vic0>;
        interrupts = <13>;
    };
```

## Documentation/devicetree/bindings/display/apple,n72-lcd.yaml
```yaml
# SPDX-License-Identifier: (GPL-2.0-only OR BSD-2-Clause)
%YAML 1.2
---
$id: http://devicetree.org/schemas/display/apple,n72-lcd.yaml#
$schema: http://devicetree.org/meta-schemas/core.yaml#

title: Apple iPod touch 2G (N72) display controller and panel

maintainers:
  - Kailash <kailash.sudhakar@gmail.com>

description:
  CLCD and MIPI DSI master of the N72, with the panel power sequencing used
  across system sleep.

properties:
  compatible:
    const: apple,n72-lcd

  reg:
    items:
      - description: CLCD registers
      - description: MIPI DSI master registers

  reset-gpios:
    maxItems: 1

  apple,panel-id:
    $ref: /schemas/types.yaml#/definitions/uint32
    description: Panel identifier; optional.

  power-supply:
    description: Panel supply regulator.

  clocks:
    minItems: 1
    maxItems: 5
    description: Clocks, all enabled by the driver.

  backlight:
    $ref: /schemas/types.yaml#/definitions/phandle
    description: Backlight device of the panel.

required:
  - compatible
  - reg
  - reset-gpios
  - power-supply
  - clocks

additionalProperties: false

examples:
  - |
    #include <dt-bindings/gpio/gpio.h>

    lcd@38900000 {
        compatible = "apple,n72-lcd";
        reg = <0x38900000 0x2000>, <0x3d800000 0x100>;
        reset-gpios = <&gpio 15 GPIO_ACTIVE_LOW>;
        apple,panel-id = <0xa2d10784>;
        power-supply = <&ldo4>;
        clocks = <&clkgate 0 14>, <&clkgate 3 9>, <&clkgate 3 10>,
                 <&clkgate 3 11>, <&clkgate 1 19>;
        backlight = <&pmu>;
    };
```

## Documentation/devicetree/bindings/gpio/apple,s5l8720-gpio.yaml
```yaml
# SPDX-License-Identifier: (GPL-2.0-only OR BSD-2-Clause)
%YAML 1.2
---
$id: http://devicetree.org/schemas/gpio/apple,s5l8720-gpio.yaml#
$schema: http://devicetree.org/meta-schemas/core.yaml#

title: Apple S5L8720 pinctrl, GPIO, and GPIO interrupt controller

maintainers:
  - Kailash <kailash.sudhakar@gmail.com>

properties:
  compatible:
    oneOf:
      - items:
          - const: apple,s5l8720-pinctrl
          - const: apple,s5l8720-gpio
      - const: apple,s5l8720-pinctrl
      - const: apple,s5l8720-gpio

  reg:
    minItems: 1
    items:
      - description: GPIO banks
      - description: GPIO interrupt controller (optional)

  interrupts:
    minItems: 1
    maxItems: 7
    description:
      One interrupt per group of 32 GPIO interrupts; the interrupt controller
      is registered only when the second "reg" entry is present.

  gpio-controller: true

  "#gpio-cells":
    const: 2

  gpio-ranges: true

  interrupt-controller: true

  "#interrupt-cells":
    const: 2

  pinctrl-names: true
  pinctrl-0: true

  apple,pin-functions:
    $ref: /schemas/types.yaml#/definitions/uint32-matrix
    description:
      Legacy fallback list of <pin function> pairs naming pads to be put in a
      peripheral function when child pinmux nodes are not used.
    items:
      items:
        - description: GPIO number
        - description: pad function

patternProperties:
  "-pins$":
    type: object
    description: Pinmux configuration group using APPLE_PINMUX(pin, func).
    properties:
      pinmux:
        $ref: /schemas/types.yaml#/definitions/uint32-array
    required:
      - pinmux
    additionalProperties: false

required:
  - compatible
  - reg
  - gpio-controller
  - "#gpio-cells"

additionalProperties: false

examples:
  - |
    #include <dt-bindings/pinctrl/apple.h>

    pinctrl@3cf00000 {
        compatible = "apple,s5l8720-pinctrl", "apple,s5l8720-gpio";
        reg = <0x3cf00000 0x200>, <0x39700000 0x1000>;
        gpio-controller;
        #gpio-cells = <2>;
        gpio-ranges = <&gpio 0 0 120>;
        interrupt-controller;
        #interrupt-cells = <2>;
        interrupts-extended = <&vic1 1>, <&vic1 0>, <&vic0 31>,
                              <&vic0 3>, <&vic0 2>;
        pinctrl-names = "default";
        pinctrl-0 = <&i2s0_mclk_hog>;

        i2s0_mclk_hog: i2s0-mclk-pins {
            pinmux = <APPLE_PINMUX(6, 2)>;
        };

        uart1_pins: uart1-pins {
            pinmux = <APPLE_PINMUX(79, 2)>,
                     <APPLE_PINMUX(80, 2)>;
        };
    };
```

## Documentation/devicetree/bindings/gpu/apple,s5l8720-mbx.yaml
```yaml
# SPDX-License-Identifier: (GPL-2.0-only OR BSD-2-Clause)
%YAML 1.2
---
$id: http://devicetree.org/schemas/gpu/apple,s5l8720-mbx.yaml#
$schema: http://devicetree.org/meta-schemas/core.yaml#

title: Apple S5L8720 PowerVR MBX Lite GPU

maintainers:
  - Kailash <kailash.sudhakar@gmail.com>

properties:
  compatible:
    const: apple,s5l8720-mbx

  reg:
    maxItems: 2

  reg-names:
    items:
      - const: core
      - const: wrapper

  clocks:
    maxItems: 1

  interrupts:
    maxItems: 1

  apple,feed-dma:
    $ref: /schemas/types.yaml#/definitions/phandle-array
    description:
      DMA controller phandle and a channel number, used to feed the tile
      accelerator (optional).
    items:
      - items:
          - description: DMA controller
          - description: channel

  apple,framebuffer:
    $ref: /schemas/types.yaml#/definitions/phandle
    description: The boot framebuffer node.

required:
  - compatible
  - reg
  - reg-names
  - clocks
  - interrupts

additionalProperties: false

examples:
  - |
    gpu@3b000000 {
        compatible = "apple,s5l8720-mbx";
        reg = <0x3b000000 0x1000000>, <0x39400000 0x1000>;
        reg-names = "core", "wrapper";
        clocks = <&clkgate 3 5>;
        apple,feed-dma = <&dmac1 5>;
        apple,framebuffer = <&framebuffer0>;
        interrupt-parent = <&vic1>;
        interrupts = <21>;
    };
```

## Documentation/devicetree/bindings/i2c/apple,s5l8720-i2c.yaml
```yaml
# SPDX-License-Identifier: (GPL-2.0-only OR BSD-2-Clause)
%YAML 1.2
---
$id: http://devicetree.org/schemas/i2c/apple,s5l8720-i2c.yaml#
$schema: http://devicetree.org/meta-schemas/core.yaml#

title: Samsung S5L8702 / Apple S5L8720 I2C controller

maintainers:
  - Kailash <kailash.sudhakar@gmail.com>

allOf:
  - $ref: /schemas/i2c/i2c-controller.yaml#

properties:
  compatible:
    oneOf:
      - const: samsung,s5l8702-i2c
      - items:
          - const: apple,s5l8720-i2c
          - const: samsung,s5l8702-i2c

  reg:
    maxItems: 1

  interrupts:
    maxItems: 1
    description:
      Optional; without it the controller is polled.

  clocks:
    minItems: 1
    maxItems: 2
    description: Clocks, all enabled together while a transfer runs.

  clock-frequency:
    description: Bus clock frequency in Hz (up to 400000 Fast-Mode on apple,s5l8720-i2c).

  samsung,write-busy-poll:
    type: boolean
    description: See the driver.

required:
  - compatible
  - reg
  - clocks

unevaluatedProperties: false

examples:
  - |
    i2c@3c900000 {
        compatible = "apple,s5l8720-i2c", "samsung,s5l8702-i2c";
        #address-cells = <1>;
        #size-cells = <0>;
        reg = <0x3c900000 0x100>;
        interrupts = <22>;
        clock-frequency = <400000>;
        clocks = <&clkgate 1 6>, <&clkgate 4 12>;
    };
```

## Documentation/devicetree/bindings/input/apple,cd3272-mikey.yaml
```yaml
# SPDX-License-Identifier: (GPL-2.0-only OR BSD-2-Clause)
%YAML 1.2
---
$id: http://devicetree.org/schemas/input/apple,cd3272-mikey.yaml#
$schema: http://devicetree.org/meta-schemas/core.yaml#

title: Apple CD3272 "Mikey" headset remote and microphone switch

maintainers:
  - Kailash <kailash.sudhakar@gmail.com>

properties:
  compatible:
    const: apple,cd3272-mikey

  reg:
    maxItems: 1

  hp-det-gpios:
    maxItems: 1
    description: Optional headphone detect GPIO.

required:
  - compatible
  - reg

additionalProperties: false

examples:
  - |
    #include <dt-bindings/gpio/gpio.h>

    i2c {
        #address-cells = <1>;
        #size-cells = <0>;

        mikey@39 {
            compatible = "apple,cd3272-mikey";
            reg = <0x39>;
            hp-det-gpios = <&pmu 2 GPIO_ACTIVE_HIGH>;
        };
    };
```

## Documentation/devicetree/bindings/input/touchscreen/apple,n72-multitouch.yaml
```yaml
# SPDX-License-Identifier: (GPL-2.0-only OR BSD-2-Clause)
%YAML 1.2
---
$id: http://devicetree.org/schemas/input/touchscreen/apple,n72-multitouch.yaml#
$schema: http://devicetree.org/meta-schemas/core.yaml#

title: Apple iPod touch 2G (N72) Zephyr2 multi-touch controller

maintainers:
  - Kailash <kailash.sudhakar@gmail.com>

allOf:
  - $ref: /schemas/spi/spi-peripheral-props.yaml#

properties:
  compatible:
    const: apple,n72-multitouch

  reg:
    maxItems: 1

  interrupts:
    maxItems: 1

  reset-gpios:
    maxItems: 1

  vdd-supply:
    description: 1.8 V controller power supply (PMU LDO3 on N72).

  spi-max-frequency: true

  spi-cpol: true

  spi-cpha: true

  apple,min-pressure:
    $ref: /schemas/types.yaml#/definitions/uint32
    description: Optional; see the driver.

required:
  - compatible
  - reg
  - interrupts
  - reset-gpios

unevaluatedProperties: false

examples:
  - |
    #include <dt-bindings/gpio/gpio.h>
    #include <dt-bindings/interrupt-controller/irq.h>

    spi {
        #address-cells = <1>;
        #size-cells = <0>;

        touchscreen@0 {
            compatible = "apple,n72-multitouch";
            reg = <0>;
            spi-max-frequency = <4500000>;
            spi-cpol;
            spi-cpha;
            interrupts-extended = <&gpio 0x6d IRQ_TYPE_LEVEL_LOW>;
            reset-gpios = <&gpio 86 GPIO_ACTIVE_HIGH>;
        };
    };
```

## Documentation/devicetree/bindings/media/apple,s5l8720-h264.yaml
```yaml
# SPDX-License-Identifier: (GPL-2.0-only OR BSD-2-Clause)
%YAML 1.2
---
$id: http://devicetree.org/schemas/media/apple,s5l8720-h264.yaml#
$schema: http://devicetree.org/meta-schemas/core.yaml#

title: Apple S5L8720 H.264 decoder

maintainers:
  - Kailash <kailash.sudhakar@gmail.com>

properties:
  compatible:
    const: apple,s5l8720-h264

  reg:
    minItems: 1
    items:
      - description: decoder registers
      - description: reset block register (optional)

  interrupts:
    maxItems: 1

  clocks:
    minItems: 1
    maxItems: 3
    description: Clocks, all enabled together, parent first.

required:
  - compatible
  - reg
  - interrupts
  - clocks

additionalProperties: false

examples:
  - |
    video-codec@38f00000 {
        compatible = "apple,s5l8720-h264";
        reg = <0x38f00000 0x4000>, <0x3e000000 0x10>;
        interrupt-parent = <&vic1>;
        interrupts = <3>;
        clocks = <&clkgate 1 21>, <&clkgate 3 2>, <&clkgate 4 18>;
    };
```

## Documentation/devicetree/bindings/media/apple,s5l8720-mpvd.yaml
```yaml
# SPDX-License-Identifier: (GPL-2.0-only OR BSD-2-Clause)
%YAML 1.2
---
$id: http://devicetree.org/schemas/media/apple,s5l8720-mpvd.yaml#
$schema: http://devicetree.org/meta-schemas/core.yaml#

title: Apple S5L8720 MPEG-4 Part 2 / H.263 decoder

maintainers:
  - Kailash <kailash.sudhakar@gmail.com>

properties:
  compatible:
    const: apple,s5l8720-mpvd

  reg:
    minItems: 7
    maxItems: 7
    description:
      Register blocks of the six decoder units in the order DDM, MP4, VLD, IQ,
      IMC, MI (the driver's unit array), followed by the reset block.

  interrupts:
    maxItems: 1

  clocks:
    minItems: 1
    maxItems: 2
    description: Clocks, all enabled together.

required:
  - compatible
  - reg
  - interrupts
  - clocks

additionalProperties: false

examples:
  - |
    video-codec@39600000 {
        compatible = "apple,s5l8720-mpvd";
        reg = <0x39600000 0x1000>, <0x39610000 0x1000>,
              <0x39630000 0x1000>, <0x39641000 0x1000>,
              <0x39650000 0x1000>, <0x39660000 0x1000>,
              <0x3e000000 0x10>;
        interrupt-parent = <&vic1>;
        interrupts = <13>;
        clocks = <&clkgate 1 21>, <&clkgate 3 3>;
    };
```

## Documentation/devicetree/bindings/media/apple,s5l8720-scaler.yaml
```yaml
# SPDX-License-Identifier: (GPL-2.0-only OR BSD-2-Clause)
%YAML 1.2
---
$id: http://devicetree.org/schemas/media/apple,s5l8720-scaler.yaml#
$schema: http://devicetree.org/meta-schemas/core.yaml#

title: Apple S5L8720 scaler and colour space converter

maintainers:
  - Kailash <kailash.sudhakar@gmail.com>

properties:
  compatible:
    const: apple,s5l8720-scaler

  reg:
    maxItems: 1

  interrupts:
    maxItems: 1

  clocks:
    maxItems: 1

required:
  - compatible
  - reg
  - interrupts
  - clocks

additionalProperties: false

examples:
  - |
    scaler@39000000 {
        compatible = "apple,s5l8720-scaler";
        reg = <0x39000000 0x1000>;
        interrupt-parent = <&vic1>;
        interrupts = <5>;
        clocks = <&clkgate 3 4>;
    };
```
