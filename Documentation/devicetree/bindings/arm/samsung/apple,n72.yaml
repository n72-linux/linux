## Documentation/devicetree/bindings/spi/apple,s5l8720-spi.yaml
```yaml
# SPDX-License-Identifier: (GPL-2.0-only OR BSD-2-Clause)
%YAML 1.2
---
$id: http://devicetree.org/schemas/spi/apple,s5l8720-spi.yaml#
$schema: http://devicetree.org/meta-schemas/core.yaml#

title: Apple S5L8720 SPI controller

maintainers:
  - Kailash <kailash.sudhakar@gmail.com>

description:
  Chip selects are GPIOs (cs-gpios).

allOf:
  - $ref: spi-controller.yaml#

properties:
  compatible:
    const: apple,s5l8720-spi

  reg:
    maxItems: 1

  interrupts:
    maxItems: 1
    description: Optional; enables interrupt-driven PIO for multi-word transfers.

  clocks:
    minItems: 1
    maxItems: 2
    description: Clocks, enabled together while the controller is in use.

  clock-frequency: true

  apple,tx-dma:
    $ref: /schemas/types.yaml#/definitions/phandle-array
    items:
      - items:
          - description: PL080 DMAC phandle
          - description: DMA channel index
          - description: DMA hardware request line
    description: Optional PL080 TX DMA channel specification for long TX-only transfers.

required:
  - compatible
  - reg
  - clocks
  - cs-gpios

unevaluatedProperties: false

examples:
  - |
    #include <dt-bindings/gpio/gpio.h>

    spi@3e100000 {
        compatible = "apple,s5l8720-spi";
        reg = <0x3e100000 0x100>;
        interrupt-parent = <&vic1>;
        interrupts = <23>;
        apple,tx-dma = <&dmac1 3 6>;
        #address-cells = <1>;
        #size-cells = <0>;
        clock-frequency = <24000000>;
        clocks = <&clkgate 2 4>, <&clkgate 4 20>;
        cs-gpios = <&gpio 87 GPIO_ACTIVE_LOW>;
    };
```

## Documentation/devicetree/bindings/timer/samsung,s5l8720-timer.yaml
```yaml
# SPDX-License-Identifier: (GPL-2.0-only OR BSD-2-Clause)
%YAML 1.2
---
$id: http://devicetree.org/schemas/timer/samsung,s5l8720-timer.yaml#
$schema: http://devicetree.org/meta-schemas/core.yaml#

title: Samsung S5L8720 timer

maintainers:
  - Kailash <kailash.sudhakar@gmail.com>

description:
  The S5L8720 timer block. Its free-running 64-bit counter (TIMER64) is the
  clocksource and sched_clock; timer E is the clock event device. The
  block's clock gate must already be open; the binding has no clocks.

properties:
  compatible:
    const: samsung,s5l8720-timer

  reg:
    maxItems: 1

  interrupts:
    maxItems: 1
    description: Timer E.

  clock-frequency:
    description:
      Rate of the 64-bit counter. Without it the driver assumes the 2 MHz of
      the iPod nanos; on the iPod touch 2G it runs at 12 MHz.

required:
  - compatible
  - reg
  - interrupts

additionalProperties: false

examples:
  - |
    timer@3c700000 {
        compatible = "samsung,s5l8720-timer";
        reg = <0x3c700000 0x20000>;
        clock-frequency = <12000000>;
        interrupts = <7>;
    };
```
